#include "DHT.h"
#define DHT11Pin 2
#define DHTType DHT11
//OLED
#include   <Wire.h>
#include <Adafruit_GFX.h>
#include <Adafruit_SSD1306.h>
#include <Fonts/FreeMonoBold9pt7b.h>
#include <Fonts/FreeMono9pt7b.h>
#include <Fonts/Org_01.h>

DHT   HT(DHT11Pin, DHTType);
float humi;
float tempC;
float tempF;

bool lockStatus = true;



#define SCREEN_WIDTH 128
#define SCREEN_HEIGHT   64 
Adafruit_SSD1306 display(SCREEN_WIDTH, SCREEN_HEIGHT,   &Wire, -1);

// 'icon_info', 16x16px
const unsigned char epd_bitmap_icon_info [] PROGMEM = {
  0x00, 0x00, 0x07, 0xe0, 0x08, 0x10, 0x00, 0x00, 0x21, 0x84, 0x40, 0x02, 0x40, 0x02, 0x41, 0x82,
  0x41, 0x82, 0x41, 0x82, 0x41, 0x82, 0x21, 0x84, 0x00, 0x00, 0x08, 0x10, 0x07, 0xe0, 0x00, 0x00
};
// 'icon_battery', 16x16px
const unsigned char epd_bitmap_icon_battery [] PROGMEM = {
  0x00, 0x00, 0x00, 0x00, 0x00, 0x00, 0x00, 0x00, 0x3f, 0xf8, 0x40, 0x04, 0x5b, 0x66, 0x5b, 0x66,
  0x5b, 0x66, 0x40, 0x04, 0x3f, 0xf8, 0x00, 0x00, 0x00, 0x00, 0x00, 0x00, 0x00, 0x00, 0x00, 0x00
};
// 'icon_lock', 16x16px
const unsigned char epd_bitmap_icon_lock [] PROGMEM = {
  0x00, 0x00, 0x01, 0x80, 0x04, 0x20, 0x00, 0x00, 0x00, 0x00, 0x0b, 0xc0, 0x0c, 0x20, 0x08, 0x10,
  0x10, 0x08, 0x11, 0x88, 0x11, 0x88, 0x10, 0x00, 0x08, 0x10, 0x04, 0x20, 0x01, 0x80, 0x00, 0x00
};
// 'icon_weather', 16x16px
const unsigned char epd_bitmap_icon_weather [] PROGMEM = {
  0x00, 0x00, 0x00, 0x00, 0x00, 0x00, 0x01, 0x30, 0x02, 0x08, 0x14, 0x08, 0x20, 0x00, 0x40, 0x04,
  0x80, 0x01, 0x80, 0x01, 0x80, 0x01, 0x40, 0x00, 0x3f, 0xfc, 0x00, 0x00, 0x00, 0x00, 0x00, 0x00
};

// Array of all bitmaps
const int epd_bitmap_allArray_LEN = 4;
const unsigned char* bitmap_icons[4] = {
  epd_bitmap_icon_battery,
  epd_bitmap_icon_info,
  epd_bitmap_icon_lock,
  epd_bitmap_icon_weather
};


// 'info', 128x64px
const unsigned char info [] PROGMEM = {
  0x00, 0x00, 0x00, 0x00, 0x00, 0x00, 0x00, 0x00, 0x00, 0x00, 0x00, 0x00, 0x00, 0x00, 0x00, 0x00,
  0x00, 0x00, 0x00, 0x00, 0x00, 0x00, 0x00, 0x00, 0x00, 0x00, 0x00, 0x00, 0x00, 0x00, 0x00, 0x00,
  0x00, 0x00, 0x00, 0x00, 0x00, 0x00, 0x00, 0x00, 0x00, 0x00, 0x00, 0x00, 0x00, 0x00, 0x00, 0x00,
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  0x00, 0x00, 0x00, 0x00, 0x00, 0x00, 0x00, 0x00, 0x00, 0x00, 0x00, 0x00, 0x00, 0x00, 0x00, 0x00
};
// 'battery', 128x64px
const unsigned char battery [] PROGMEM = {
  0x00, 0x00, 0x00, 0x00, 0x00, 0x00, 0x00, 0x00, 0x00, 0x00, 0x00, 0x00, 0x00, 0x00, 0x00, 0x00,
  0x00, 0x00, 0x00, 0x00, 0x00, 0x00, 0x00, 0x00, 0x00, 0x00, 0x00, 0x00, 0x00, 0x00, 0x00, 0x00,
  0x00, 0x00, 0x00, 0x00, 0x00, 0x00, 0x00, 0x00, 0x00, 0x00, 0x00, 0x00, 0x00, 0x00, 0x00, 0x00,
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  0x00, 0x00, 0x00, 0x00, 0x00, 0x00, 0x00, 0x00, 0x00, 0x00, 0x00, 0x00, 0x00, 0x00, 0x00, 0x00
};
// 'lock', 128x64px
const unsigned char lock [] PROGMEM = {
  0x00, 0x00, 0x00, 0x00, 0x00, 0x00, 0x00, 0x00, 0x00, 0x00, 0x00, 0x00, 0x00, 0x00, 0x00, 0x00,
  0x00, 0x00, 0x00, 0x00, 0x00, 0x00, 0x00, 0x00, 0x00, 0x00, 0x00, 0x00, 0x00, 0x00, 0x00, 0x00,
  0x00, 0x00, 0x00, 0x00, 0x00, 0x00, 0x00, 0x00, 0x00, 0x00, 0x00, 0x00, 0x00, 0x00, 0x00, 0x00,
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  0x00, 0x00, 0x00, 0x00, 0x00, 0x00, 0x00, 0x00, 0x00, 0x00, 0x00, 0x00, 0x00, 0x00, 0x00, 0x00
};
// 'unlock', 128x64px
const unsigned char unlock [] PROGMEM = {
  0x00, 0x00, 0x00, 0x00, 0x00, 0x00, 0x00, 0x00, 0x00, 0x00, 0x00, 0x00, 0x00, 0x00, 0x00, 0x00,
  0x00, 0x00, 0x00, 0x00, 0x00, 0x00, 0x00, 0x00, 0x00, 0x00, 0x00, 0x00, 0x00, 0x00, 0x00, 0x00,
  0x00, 0x00, 0x00, 0x00, 0x00, 0x00, 0x00, 0x00, 0x00, 0x00, 0x00, 0x00, 0x00, 0x00, 0x00, 0x00,
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  0x00, 0x00, 0x00, 0x00, 0x00, 0x00, 0x00, 0x00, 0x00, 0x00, 0x00, 0x00, 0x00, 0x00, 0x00, 0x00
};



const unsigned char* bitmap_screenshots[4] = {
  battery,
  info,
  lock,
  unlock
};


// 'qr_turbo', 128x64px
const unsigned char bitmap_qr_info [] PROGMEM = {
  0xaa, 0xaa, 0xaa, 0xaa, 0xaa, 0xaa, 0xaa, 0xaa, 0xaa, 0xaa, 0xaa, 0xaa, 0xaa, 0xaa, 0xaa, 0xaa,
  0x55, 0x55, 0x55, 0x55, 0x55, 0x55, 0x55, 0x55, 0x55, 0x55, 0x55, 0x55, 0x55, 0x55, 0x55, 0x55,
  0xaa, 0xaa, 0xaa, 0xaa, 0xaa, 0xaa, 0xaa, 0xaa, 0xaa, 0xaa, 0xaa, 0xaa, 0xaa, 0xaa, 0xaa, 0xaa,
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  0x55, 0x55, 0x55, 0x55, 0x55, 0x55, 0x55, 0x55, 0x55, 0x55, 0x55, 0x55, 0x55, 0x55, 0x55, 0x55
};


const unsigned char* bitmap_qr_codes[1] = {
  bitmap_qr_info
};

// 'scrollbar_background
const unsigned char bitmap_scrollbar_background [] PROGMEM = {
  0x00, 0x02, 0x00, 0x02, 0x00, 0x02, 0x00, 0x02, 0x00, 0x02, 0x00, 0x02, 0x00, 0x02, 0x00, 0x02,
  0x00, 0x02, 0x00, 0x02, 0x00, 0x02, 0x00, 0x02, 0x00, 0x02, 0x00, 0x02, 0x00, 0x02, 0x00, 0x02,
  0x00, 0x02, 0x00, 0x02, 0x00, 0x02, 0x00, 0x02, 0x00, 0x02, 0x00, 0x02, 0x00, 0x02, 0x00, 0x02,
  0x00, 0x02, 0x00, 0x02, 0x00, 0x02, 0x00, 0x02, 0x00, 0x02, 0x00, 0x02, 0x00, 0x02, 0x00, 0x00
};

// 'item_sel_outline'
const unsigned char bitmap_item_sel_outline [] PROGMEM = {
  0x1f, 0xff, 0xff, 0xff, 0xff, 0xff, 0xff, 0xff, 0xff, 0xff, 0xff, 0xff, 0xff, 0xff, 0xff, 0xc0,
  0x20, 0x00, 0x00, 0x00, 0x00, 0x00, 0x00, 0x00, 0x00, 0x00, 0x00, 0x00, 0x00, 0x00, 0x00, 0x20,
  0x40, 0x00, 0x00, 0x00, 0x00, 0x00, 0x00, 0x00, 0x00, 0x00, 0x00, 0x00, 0x00, 0x00, 0x00, 0x30,
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  0x1f, 0xff, 0xff, 0xff, 0xff, 0xff, 0xff, 0xff, 0xff, 0xff, 0xff, 0xff, 0xff, 0xff, 0xff, 0xc0
};



const int NUM_ITEMS = 4; // number of items in the list and also the number of screenshots and screenshots with QR codes (other screens)
const int MAX_ITEM_LENGTH = 20; 

char menu_items [NUM_ITEMS] [MAX_ITEM_LENGTH] = {  // array with item names
  { "Battery" },
  { "Info" },
  { "Lock" },
  { "Weather" }
};

#define BUTTON_UP_PIN 12 
#define BUTTON_SELECT_PIN 8 
#define BUTTON_DOWN_PIN 13 




int button_up_clicked = 0; 
int button_select_clicked = 0; 
int button_down_clicked = 0; 

int item_selected = 0; 

int item_sel_previous; 
int item_sel_next; 

int current_screen = 0;


void setup() {

  pinMode(BUTTON_UP_PIN, INPUT_PULLUP); // up button
  pinMode(BUTTON_SELECT_PIN, INPUT_PULLUP); // select button
  pinMode(BUTTON_DOWN_PIN, INPUT_PULLUP); // down button
  Serial.begin(9600);
  //For DHT11
  HT.begin();
  //For OLED I2C
  if (!display.begin(SSD1306_SWITCHCAPVCC, 0x3C))   { // Address 0x3D for 128x64
    // Serial.println(F("SSD1306 allocation failed"));
    for (;;);
  }
  display.display(); //Display logo
  delay(1000);
  display.clearDisplay();
}

void loop() {
  delay(500);
  humi =   HT.readHumidity();
  tempC = HT.readTemperature();
  tempF = HT.readTemperature(true);
  
String humiStr = String(humi, 2);
String tempCStr = String(tempC, 3);


  // String jsonStr = "{";
  // jsonStr += "\"humi\":" + String(humi, 2) + ",";
  // jsonStr += "\"tempC\":" + String(tempC, 1) + ",";
  // jsonStr += "\"lockStatus\":" + String(lockStatus ? "true" : "false");
  // jsonStr += "}";

  // Serial.println(jsonStr);

  String a = String(humi,0);
  String b = String(tempC,1);

    //  Serial.print("Humidity:");
   Serial.println(a+","+b + "," + lockStatus);
  //  Serial.print(",");
  //   //  Serial.print(" Temperature:");
  //  Serial.print(tempC,1);
  //  Serial.print(",");
  // //  Serial.print(tempF,1);
  // //  Serial.println("F");
  // // Serial.print("Status :");
  // Serial.println(lockStatus ? "true" : "false");
  display.clearDisplay();

  if (current_screen == 1) { // MENU SCREEN

    // up and down buttons only work for the menu screen
    if ((digitalRead(BUTTON_UP_PIN) == LOW) && (button_up_clicked == 0)) { // up button clicked - jump to previous menu item
      item_selected = item_selected - 1; // select previous item
      button_up_clicked = 1; // set button to clicked to only perform the action once
      if (item_selected < 0) { // if first item was selected, jump to last item
        item_selected = NUM_ITEMS - 1;
      }
    }
    else if ((digitalRead(BUTTON_DOWN_PIN) == LOW) && (button_down_clicked == 0)) { // down button clicked - jump to next menu item
      item_selected = item_selected + 1; // select next item
      button_down_clicked = 1; // set button to clicked to only perform the action once
      if (item_selected >= NUM_ITEMS) { // last item was selected, jump to first menu item
        item_selected = 0;
      }
    }

    if ((digitalRead(BUTTON_UP_PIN) == HIGH) && (button_up_clicked == 1)) { // unclick
      button_up_clicked = 0;
    }
    if ((digitalRead(BUTTON_DOWN_PIN) == HIGH) && (button_down_clicked == 1)) { // unclick
      button_down_clicked = 0;
    }

  }

  if ((digitalRead(BUTTON_SELECT_PIN) == LOW) && (button_select_clicked == 0)) { // select button clicked, jump between screens
    button_select_clicked = 1; // set button to clicked to only perform the action once
    if (current_screen == 0) {
      current_screen = 1; //qr screen --> menu
    }
    else if (current_screen == 1) {
      current_screen = 2; //menu--> selected screen
    }
    else {
      current_screen = 1;
    }
  }
  if ((digitalRead(BUTTON_SELECT_PIN) == HIGH) && (button_select_clicked == 1)) { // unclick
    button_select_clicked = 0;
  }

  // set correct values for the previous and next items
  item_sel_previous = item_selected - 1;
  if (item_sel_previous < 0) {
    item_sel_previous = NUM_ITEMS - 1; // previous item would be below first = make it the last
  }
  item_sel_next = item_selected + 1;
  if (item_sel_next >= NUM_ITEMS) {
    item_sel_next = 0; // next item would be after last = make it the first
  }


  if (current_screen == 0) { // QR SCREEN
    display.clearDisplay();
    display.drawBitmap(0, 0, bitmap_qr_codes[item_selected], 128, 64, WHITE);// draw qr code screenshot

  }
  else if (current_screen == 1) { // MENU

    display.clearDisplay();
    display.setTextColor(SSD1306_WHITE);  // Set text color to white
    display.setTextSize(0);  // Choose text size (you can change this value)
    display.setFont(&FreeMono9pt7b);  // Set the font

    // Draw the text
    display.setCursor(25, 15);
    display.print(menu_items[item_sel_previous]);
    display.drawBitmap(0, 22, bitmap_item_sel_outline, 128, 21, WHITE);

    // Draw the previous item as icon + label
    display.setFont(&FreeMono9pt7b);
    display.setCursor(25, 15);
    display.print(menu_items[item_sel_previous]);
    display.drawBitmap(4, 2, bitmap_icons[item_sel_previous], 16, 16, WHITE);

    // Draw the selected item as icon + label in bold font
    display.setFont(&FreeMonoBold9pt7b);
    display.setCursor(25, 15 + 20 + 2);
    display.print(menu_items[item_selected]);
    display.drawBitmap(4, 24, bitmap_icons[item_selected], 16, 16, WHITE);

    // Draw the next item as icon + label
    display.setFont(&FreeMono9pt7b);
    display.setCursor(25, 15 + 20 + 20 + 2 + 2);
    display.print(menu_items[item_sel_next]);
    display.drawBitmap(4, 46, bitmap_icons[item_sel_next], 16, 16, WHITE);

    // Draw scrollbar background
    display.drawBitmap(120, 0, bitmap_scrollbar_background, 8, 64, WHITE);

    // Draw scrollbar handle
    display.fillRect(125, 64 / NUM_ITEMS * item_selected, 3, 64 / NUM_ITEMS, WHITE);


    display.display();
  }
  else if (current_screen == 2)
    if (item_selected == 3) {
      display.clearDisplay();
      oledDisplayHeader();
      oledDisplay(3, 5, 35, humi, "%");
      oledDisplay(2, 70, 25, tempC, "C");
      oledDisplay(2, 70, 53, tempF, "F");
      display.display();
    } else if (item_selected == 2) {  // Code for the lock unlock when up clicked and down clicked button
      if ((digitalRead(BUTTON_UP_PIN) == LOW) && (button_up_clicked == 0)) {
        button_up_clicked = 0; // set button to clicked to only perform the action once
        display.drawBitmap( 0, 0, bitmap_screenshots[2], 128, 64, WHITE);
        lockStatus = false;
      }
      else if ((digitalRead(BUTTON_DOWN_PIN) == LOW) && (button_down_clicked == 0)) { // down button clicked - jump to next menu item
        button_down_clicked = 0; // set button to clicked to only perform the action once
        display.clearDisplay();
        lockStatus = true;
        display.drawBitmap( 0, 0, bitmap_screenshots[3], 128, 64, WHITE);
      } else if ((digitalRead(BUTTON_SELECT_PIN) == LOW) && (button_select_clicked == 0)) { // select button clicked, jump between screens
        button_select_clicked = 1; // set button to clicked to only perform the action once
        current_screen = 1; //qr screen --> menu
      }
    }
    else {
      display.clearDisplay();
      display.drawBitmap( 0, 0, bitmap_screenshots[item_selected], 128, 64, WHITE);
    }
  display.display();
}


void   oledDisplayHeader() {
  display.clearDisplay();
  display.setTextSize(15 / 10);
  display.setTextColor(SSD1306_WHITE);
  display.setFont(&Org_01);
  display.setCursor(2, 10);
  display.print("Humidity");
  display.setCursor(60,   10);
  display.print("Temperature");
}
void oledDisplay(int size, int x, int   y, float value, String unit) {
  int charLen = 12;
  int xo = x + charLen * 3.2;
  int xunit = x + charLen * 3.6;
  int xval = x;
  display.setTextSize(size);
  display.setTextColor(WHITE);

  if (unit == "%") {
    display.setCursor(x, y);
    display.print(value, 0);
    display.print(unit);
  } else {
    if (value > 99) {
      xval = x;
    }   else {
      xval = x + charLen;
    }
    display.setCursor(xval, y);
    display.print(value, 0);
    display.drawCircle(xo, y + 2, 2, WHITE); // print degree symbols (  )
    display.setCursor(xunit,   y);
    display.print(unit);
  }
}


